## conf/machine/balto.conf
```bitbake
#@TYPE: Machine
#@NAME: BaltoBoard
#@SOC: RZ/A1
#@DESCRIPTION: Machine configuration for Balto Board RZ/A1H
#@MAINTAINER: Pierluigi Passaro <info@phoenixsoftware.it>

require conf/machine/include/rza1.inc

SERIAL_CONSOLES = "115200;ttySC3"

UBOOT_MACHINE = "balto_config"
KERNEL_DEVICETREE = "r7s72100-balto.dtb"
KERNEL_IMAGETYPE = "uImage"
PREFERRED_VERSION_u-boot-rza1 = "2013.04"
PREFERRED_PROVIDER_virtual/kernel = "linux-baltoboard"
```

## conf/machine/include/rza1.inc
```bitbake
# Ship all kernel modules by default
MACHINE_EXTRA_RRECOMMENDS = " kernel-modules"

DEFAULTTUNE = "cortexa9thf-neon"
include conf/machine/include/tune-cortexa9.inc
include conf/machine/include/soc-family.inc

SOC_FAMILY = "rza1"

PREFERRED_PROVIDER_virtual/kernel ??= "linux-rza1"
PREFERRED_PROVIDER_u-boot ??= "u-boot-rza1"
PREFERRED_PROVIDER_jpeg ??= "libjpeg-turbo"
```

## conf/machine/rskrza1.conf
```bitbake
#@TYPE: Machine
#@NAME: RSKRZA1
#@SOC: RZ/A1
#@DESCRIPTION: Machine configuration for RSKRZA1 board
#@MAINTAINER: Pierluigi Passaro <info@phoenixsoftware.it>

require conf/machine/include/rza1.inc

SERIAL_CONSOLES = "115200;ttySC2"

UBOOT_MACHINE = "rskrza1_config"
KERNEL_DEVICETREE = "r7s72100-rskrza1.dtb"
KERNEL_IMAGETYPE = "uImage"
```
